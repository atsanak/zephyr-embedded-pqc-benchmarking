## CMakeLists.txt
```
# SPDX-License-Identifier: LicenseRef-Proprietary-Collaborative-Evaluation

cmake_minimum_required(VERSION 3.20.0)

set(PQCP_LOCAL_MODULE_ROOT "${CMAKE_CURRENT_LIST_DIR}/../..")
include(${PQCP_LOCAL_MODULE_ROOT}/cmake/pqcp_local_module.cmake)

find_package(Zephyr REQUIRED HINTS $ENV{ZEPHYR_BASE})
project(pqcp_tls_mbedtls_psa)

target_sources(app PRIVATE src/main.c)
```

## prj.conf
```kconfig
# PQCP TLS mbedTLS PSA Sample - Base Configuration
CONFIG_PQCP=y
CONFIG_PQCP_TLS_SELFTEST=y
CONFIG_PQCP_MLKEM=y
CONFIG_PQCP_MLKEM_LEVEL_768=y
CONFIG_PQCP_MLDSA=y
CONFIG_PQCP_MLDSA_LEVEL_65=y

# RNG
CONFIG_ENTROPY_GENERATOR=y
CONFIG_PQCP_RNG_PSA=y

# PSA Driver
CONFIG_PQCP_PSA_DRIVER=y
CONFIG_PQCP_PSA_DRIVER_MLDSA=y
CONFIG_PQCP_PSA_DRIVER_MLKEM=y

# Stack
# Match the validated PQC self-test stack budget used by the protocol bench
# and TLS helper tests.
CONFIG_MAIN_STACK_SIZE=131072

# Logging
CONFIG_LOG=y
CONFIG_LOG_DEFAULT_LEVEL=3
CONFIG_LOG_PRINTK=n
```

## overlay-mbedtls.conf
```kconfig
# PQCP TLS mbedTLS PSA Overlay
# Include this to enable mbedTLS with PSA Crypto

# mbedTLS configuration
CONFIG_MBEDTLS=y
CONFIG_MBEDTLS_BUILTIN=y
CONFIG_MBEDTLS_ENABLE_HEAP=y
CONFIG_MBEDTLS_HEAP_SIZE=131072

# PSA Crypto
CONFIG_MBEDTLS_PSA_CRYPTO_C=y

# TLS configuration
CONFIG_MBEDTLS_SSL_MAX_CONTENT_LEN=16384

# Networking (for real TLS)
CONFIG_NETWORKING=y
CONFIG_NET_IPV4=y
CONFIG_NET_TCP=y
CONFIG_NET_SOCKETS=y
CONFIG_POSIX_API=y
```

## overlay-selftest.conf
```kconfig
# PQCP TLS mbedTLS PSA Overlay - Selftest Only (No Networking)
# Use this for running crypto selftests without host network setup
#
# Build: west build -b qemu_x86_64 -- -DOVERLAY_CONFIG=overlay-selftest.conf

# mbedTLS configuration
CONFIG_MBEDTLS=y
CONFIG_MBEDTLS_BUILTIN=y
CONFIG_MBEDTLS_ENABLE_HEAP=y
CONFIG_MBEDTLS_HEAP_SIZE=131072

# PSA Crypto (required for PSA driver tests)
CONFIG_MBEDTLS_PSA_CRYPTO_C=y

# No networking - selftest only
CONFIG_NETWORKING=n
CONFIG_THREAD_STACK_INFO=y
CONFIG_INIT_STACKS=y
```

## src/main.c
```c
/*
 * SPDX-License-Identifier: LicenseRef-Proprietary-Collaborative-Evaluation
 *
 * PQCP TLS mbedTLS PSA Sample
 *
 * Demonstrates TLS with post-quantum cryptography using mbedTLS and PSA.
 * Note: Full PQC TLS requires mbedTLS PQC support which is still evolving.
 * This sample demonstrates the PSA driver integration and basic TLS.
 */

#include <zephyr/kernel.h>
#include <zephyr/sys/printk.h>
#include <pqcp_zephyr/mldsa.h>
#include <pqcp_zephyr/mlkem.h>
#include <pqcp_zephyr/tls_selftest.h>

/* Placeholder for actual TLS handshake */
static void demo_tls_usage(void)
{
    printk("\n--- TLS Integration Notes ---\n");
    printk("\n");
    printk("To use PQC in TLS with mbedTLS:\n");
    printk("\n");
    printk("1. mbedTLS ML-KEM support is in development (see issue #9803)\n");
    printk("2. Hybrid key exchange (X25519 + ML-KEM) expected in future\n");
    printk("3. ML-DSA certificates need X.509 PQC OID support\n");
    printk("\n");
    printk("Current integration path:\n");
    printk("  - Use PQCP PSA drivers for ML-DSA signing\n");
    printk("  - Use PQCP for out-of-band key encapsulation\n");
    printk("  - Wait for mbedTLS TLS 1.3 PQC groups\n");
    printk("\n");
    printk("Key sizes for TLS planning:\n");
    printk("  ML-KEM-768:  pk=%zu ct=%zu ss=%d\n",
           pqcp_mlkem_pk_size(PQCP_MLKEM_768),
           pqcp_mlkem_ct_size(PQCP_MLKEM_768),
           PQCP_MLKEM_SS_SIZE);
    printk("  ML-DSA-65:   pk=%zu sig=%zu\n",
           pqcp_mldsa_pk_size(PQCP_MLDSA_65),
           pqcp_mldsa_sig_size(PQCP_MLDSA_65));
    printk("\n");
    printk("Estimated TLS 1.3 handshake overhead:\n");
    printk("  Hybrid (X25519+ML-KEM-768):  +1184 pk +1088 ct = ~2.3KB extra\n");
    printk("  ML-DSA-65 cert:              +1952 pk +3293 sig = ~5.2KB extra\n");
    printk("  Total extra for PQC:         ~7-10KB per handshake\n");
}

int main(void)
{
    pqcp_tls_selftest_config_t cfg = {
        .kem_level = 768,
        .sig_level = 65,
        .initialize_rng = true,
        .initialize_psa = true,
        .emit_metrics = true,
    };
    pqcp_tls_selftest_report_t report;
    bool psa_ready = false;
    int ret;

    printk("\n");
    printk("========================================\n");
    printk("  PQCP TLS mbedTLS PSA Sample\n");
    printk("========================================\n\n");

    printk("Initializing shared TLS self-test path...\n");

    ret = pqcp_tls_selftest_init_psa(&psa_ready);
    if (ret == 0) {
        printk("PSA Crypto initialized successfully\n");
        cfg.initialize_psa = false;
    } else {
        printk("WARNING: PSA init failed, continuing with PQCP-only flow\n");
        cfg.initialize_psa = false;
    }

    ret = pqcp_tls_selftest_run(&cfg, &report);
    if (ret != 0) {
        printk("\nERROR: PQCP TLS self-test failed: %d\n", ret);
        return -1;
    }
    report.psa_ready = psa_ready;

    printk("\n--- Shared TLS Self-Test Report ---\n");
    printk("ML-KEM-%u keygen:   %llu us\n",
           report.kem_level, report.kem_keygen_us);
    printk("ML-KEM-%u encaps:   %llu us\n",
           report.kem_level, report.kem_encaps_us);
    printk("ML-KEM-%u decaps:   %llu us\n",
           report.kem_level, report.kem_decaps_us);
    printk("ML-DSA-%u keygen:   %llu us\n",
           report.sig_level, report.sig_keygen_us);
    printk("ML-DSA-%u sign:     %llu us\n",
           report.sig_level, report.sig_sign_us);
    printk("ML-DSA-%u verify:   %llu us\n",
           report.sig_level, report.sig_verify_us);
    printk("Auth stage:         %llu us\n", report.auth_us);
    printk("Key exchange stage: %llu us\n", report.key_exchange_us);
    printk("Handshake total:    %llu us\n", report.handshake_us);
    printk("Client payload:     %u bytes\n", report.client_bytes);
    printk("Server payload:     %u bytes\n", report.server_bytes);
    printk("Transcript total:   %u bytes\n", report.transcript_bytes);
    printk("Packets (approx):   %u\n", report.packets);
    if (report.stack_bytes > 0U) {
        printk("Stack usage:        %u bytes\n", report.stack_bytes);
    }
    printk("Working set:        %u bytes\n", report.working_set_bytes);
    printk("PSA active:         %s\n", psa_ready ? "yes" : "no");

    /* Show TLS integration notes */
    demo_tls_usage();

    printk("========================================\n");
    printk("  Sample completed successfully!\n");
    printk("========================================\n");

    return 0;
}
```

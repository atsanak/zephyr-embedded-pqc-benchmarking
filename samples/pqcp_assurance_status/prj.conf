## CMakeLists.txt
```
# SPDX-License-Identifier: LicenseRef-Proprietary-Collaborative-Evaluation

cmake_minimum_required(VERSION 3.20.0)

set(PQCP_LOCAL_MODULE_ROOT "${CMAKE_CURRENT_LIST_DIR}/../..")
include(${PQCP_LOCAL_MODULE_ROOT}/cmake/pqcp_local_module.cmake)

find_package(Zephyr REQUIRED HINTS $ENV{ZEPHYR_BASE})
project(pqcp_assurance_status)

if(DEFINED PQCP_ASSURANCE_DIGEST_INCLUDE_DIR)
  target_include_directories(app BEFORE PRIVATE ${PQCP_ASSURANCE_DIGEST_INCLUDE_DIR})
endif()
target_include_directories(app PRIVATE ${CMAKE_CURRENT_SOURCE_DIR}/src)

target_sources(app PRIVATE src/main.c)
```

## prj.conf
```kconfig
# SPDX-License-Identifier: LicenseRef-Proprietary-Collaborative-Evaluation

CONFIG_PRINTK=y
CONFIG_PQCP=y
CONFIG_PQCP_MLKEM=n
CONFIG_PQCP_MLDSA=n
CONFIG_PQCP_RNG_CUSTOM=y
CONFIG_PQCP_PROVIDER_CONTRACT=y
CONFIG_PQCP_BUILD_MANIFEST=y
CONFIG_PQCP_EVIDENCE_SESSION=y
CONFIG_PQCP_FIRMWARE_POLICY=y
CONFIG_PQCP_CAPABILITY_DESCRIPTOR=y
CONFIG_PQCP_FIRMWARE_EVIDENCE=y
CONFIG_PQCP_ASSURANCE_STATUS=y
```

## src/main.c
```c
/*
 * SPDX-License-Identifier: LicenseRef-Proprietary-Collaborative-Evaluation
 *
 * Build-only assurance status sample.
 */

#include <zephyr/kernel.h>
#include <zephyr/sys/util.h>
#include <zephyr/sys/printk.h>

#include <pqcp_zephyr/assurance.h>
#include <pqcp_zephyr/firmware_evidence.h>

#include <pqcp_assurance_digest_generated.h>

static struct pqcp_assurance_artifact
	pqcp_sample_artifacts[ARRAY_SIZE(pqcp_assurance_digest_artifact_names)];

static void pqcp_sample_populate_artifacts(void)
{
	for (size_t i = 0; i < PQCP_ASSURANCE_DIGEST_ARTIFACT_COUNT; ++i) {
		pqcp_sample_artifacts[i].name =
			pqcp_assurance_digest_artifact_names[i];
		pqcp_sample_artifacts[i].sha256 =
			pqcp_assurance_digest_artifact_sha256[i];
	}
}

int main(void)
{
	struct pqcp_firmware_evidence_result result;
	const struct pqcp_assurance_manifest manifest = {
		.version = PQCP_ASSURANCE_DIGEST_VERSION,
		.digest_sha256 = PQCP_ASSURANCE_DIGEST_ROOT_SHA256,
		.schema_version = PQCP_ASSURANCE_DIGEST_SCHEMA_VERSION,
		.artifacts = PQCP_ASSURANCE_DIGEST_ARTIFACT_COUNT > 0 ?
			pqcp_sample_artifacts : NULL,
		.artifact_count = PQCP_ASSURANCE_DIGEST_ARTIFACT_COUNT,
	};

	pqcp_sample_populate_artifacts();

	if (pqcp_firmware_evidence_run_default(
		&manifest,
		PQCP_ASSURANCE_DEVICE_EVIDENCE_NONCE,
		PQCP_ASSURANCE_DEVICE_EVIDENCE_TRANSCRIPT_SHA256,
		&result) != 0) {
		printk("PROJECT EXECUTION FAILED\n");
		return 1;
	}

	printk("PROJECT EXECUTION SUCCESSFUL\n");
	return 0;
}
```

## src/pqcp_assurance_digest_generated.h
```c
/*
 * SPDX-License-Identifier: LicenseRef-Proprietary-Collaborative-Evaluation
 *
 * Fallback header for standalone sample builds. Release validation passes a
 * generated include directory ahead of this path.
 */

#ifndef PQCP_ASSURANCE_DIGEST_GENERATED_H_
#define PQCP_ASSURANCE_DIGEST_GENERATED_H_

#define PQCP_ASSURANCE_DIGEST_SOURCE "fallback"
#define PQCP_ASSURANCE_DIGEST_VERSION "unknown"
#define PQCP_ASSURANCE_DIGEST_ALGORITHM "sha256"
#define PQCP_ASSURANCE_DIGEST_SCHEMA_VERSION 1
#define PQCP_ASSURANCE_DIGEST_ARTIFACT_COUNT 0
#define PQCP_ASSURANCE_DIGEST_ROOT_SHA256 "0000000000000000000000000000000000000000000000000000000000000000"
#define PQCP_ASSURANCE_DEVICE_EVIDENCE_NONCE "00000000000000000000000000000000"
#define PQCP_ASSURANCE_DEVICE_EVIDENCE_TRANSCRIPT_SHA256 "0000000000000000000000000000000000000000000000000000000000000000"
#define PQCP_ASSURANCE_DIGEST_GENERATED_AT "not-generated"

static const char * const pqcp_assurance_digest_artifact_names[] = { "" };
static const char * const pqcp_assurance_digest_artifact_sha256[] = { "" };

#endif /* PQCP_ASSURANCE_DIGEST_GENERATED_H_ */
```

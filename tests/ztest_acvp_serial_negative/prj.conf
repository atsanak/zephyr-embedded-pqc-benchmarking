## CMakeLists.txt
```
# SPDX-License-Identifier: LicenseRef-Proprietary-Collaborative-Evaluation

cmake_minimum_required(VERSION 3.20.0)

set(PQCP_LOCAL_MODULE_ROOT "${CMAKE_CURRENT_LIST_DIR}/../..")
include(${PQCP_LOCAL_MODULE_ROOT}/cmake/pqcp_local_module.cmake)

find_package(Zephyr REQUIRED HINTS $ENV{ZEPHYR_BASE})
project(ztest_acvp_serial_negative)

target_sources(app PRIVATE src/main.c)
```

## prj.conf
```kconfig
# SPDX-License-Identifier: LicenseRef-Proprietary-Collaborative-Evaluation
# Zephyr Test - PQCP ACVP negative-scenario replay
CONFIG_ZTEST=y

CONFIG_PQCP=y
CONFIG_PQCP_MLKEM=y
CONFIG_PQCP_MLKEM_LEVEL_768=y
CONFIG_PQCP_MLDSA=y
CONFIG_PQCP_MLDSA_LEVEL_65=y
CONFIG_PQCP_ACVP=y
CONFIG_PQCP_ACVP_READLINE_TIMEOUT_MS=100

# Deterministic test-only RNG keeps the negative-replay deterministic.
CONFIG_PQCP_RNG_DETERMINISTIC_TEST=y

CONFIG_MAIN_STACK_SIZE=131072
CONFIG_ZTEST_STACK_SIZE=131072
CONFIG_THREAD_STACK_INFO=y
CONFIG_INIT_STACKS=y
```

## src/main.c
```c
/* SPDX-License-Identifier: LicenseRef-Proprietary-Collaborative-Evaluation */
/*
 * Negative-scenario replay for the PQCP ACVP serial harness.
 *
 * This suite drives every replay-eligible case from
 * scripts/acvp_negative_scenarios.json directly through
 * pqcp_acvp_process_command() and asserts that each one produces the
 * documented ERROR:* response on the wire. This is a stronger binding
 * than scripts/generate_assurance_ledger.py's
 * acvp.negative_path_rejection claim, which proves only that the
 * positive ztest run logged the expected suite-success markers.
 *
 * The scenarios.h header is generated by
 * scripts/generate_acvp_negative_header.py from the JSON fixture so
 * that updating one file keeps the other in lock-step.
 */

#include <string.h>

#include <zephyr/sys/printk.h>
#include <zephyr/ztest.h>

#include <pqcp_zephyr/acvp_cmd.h>

#include "scenarios.h"

#define WORK_BUFFER_BYTES PQCP_ACVP_INPUT_BYTES_MAX
#define LINE_BUFFER_BYTES (PQCP_ACVP_COMMAND_LINE_CHARS_MAX + 1U)
#define RESPONSE_BUFFER_BYTES 8192U
#define RESPONSE_LINE_BUFFER_BYTES 8192U

static uint8_t work_buffer[WORK_BUFFER_BYTES];
static uint8_t response_buffer[RESPONSE_BUFFER_BYTES];
static char line_buffer[LINE_BUFFER_BYTES];
static char response_line[RESPONSE_LINE_BUFFER_BYTES];

ZTEST(pqcp_acvp_serial_negative, test_every_negative_scenario_rejected)
{
    zassert_true(PQCP_ACVP_NEGATIVE_CASE_COUNT > 0,
                 "scenarios.h must produce at least one replay-eligible case; "
                 "regenerate via scripts/generate_acvp_negative_header.py");

    for (size_t i = 0; i < PQCP_ACVP_NEGATIVE_CASE_COUNT; ++i) {
        const struct pqcp_acvp_negative_case *tc =
            &pqcp_acvp_negative_cases[i];
        struct pqcp_acvp_response resp;
        size_t cmd_len = strlen(tc->command);

        zassert_true(cmd_len < sizeof(line_buffer),
                     "case %zu (%s): command exceeds line buffer", i, tc->name);

        memcpy(line_buffer, tc->command, cmd_len);
        line_buffer[cmd_len] = '\0';

        pqcp_acvp_response_init(&resp, response_buffer, sizeof(response_buffer));

        /*
         * pqcp_acvp_process_command() returns a negative errno-style code
         * for parse/dispatch failures; the wire-format response still has
         * to be the documented ERROR:* line. A successful return here
         * would mean a documented-malformed input was *accepted* — which
         * is exactly the regression class this test exists to catch.
         */
        (void)pqcp_acvp_process_command(line_buffer, work_buffer,
                                        sizeof(work_buffer), &resp);

        int rendered = pqcp_acvp_format_response_line(
            &resp, response_line, sizeof(response_line));
        zassert_equal(rendered, 0,
                      "case %zu (%s): format_response_line returned %d",
                      i, tc->name, rendered);

        zassert_equal(strcmp(response_line, tc->expected_response), 0,
                      "case %zu (%s): wire response %s != expected %s",
                      i, tc->name, response_line, tc->expected_response);

        /*
         * Emit a single line per case so the captured ztest transcript
         * documents exactly which negative scenarios ran and which wire
         * response each produced. Downstream assurance evaluators rely
         * on these markers (e.g. "PQCP_ACVP_NEG case=INVALID_MLKEM_ENCAPS_HEX")
         * to bind per-primitive claims to this transcript.
         */
        printk("PQCP_ACVP_NEG case=%s command=%s response=%s\n",
               tc->name, tc->command, response_line);
    }
}

ZTEST_SUITE(pqcp_acvp_serial_negative, NULL, NULL, NULL, NULL, NULL);
```

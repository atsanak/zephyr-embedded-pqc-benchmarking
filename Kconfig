## tests/ztest_acvp_kat/testcase.yaml
```yaml
tests:
  pqcp.acvp_kat.mlkem_512_keygen:
    tags:
      - pqcp
      - acvp
      - kat
    harness: ztest
    platform_allow:
      - qemu_x86_64
    integration_platforms:
      - qemu_x86_64
    timeout: 300
  pqcp.acvp_kat.mlkem_512_encaps:
    tags: [pqcp, acvp, kat]
    harness: ztest
    platform_allow: [qemu_x86_64]
    integration_platforms: [qemu_x86_64]
    timeout: 300
  pqcp.acvp_kat.mlkem_768_keygen:
    tags: [pqcp, acvp, kat]
    harness: ztest
    platform_allow: [qemu_x86_64]
    integration_platforms: [qemu_x86_64]
    timeout: 300
  pqcp.acvp_kat.mlkem_768_encaps:
    tags: [pqcp, acvp, kat]
    harness: ztest
    platform_allow: [qemu_x86_64]
    integration_platforms: [qemu_x86_64]
    timeout: 300
  pqcp.acvp_kat.mlkem_1024_keygen:
    tags: [pqcp, acvp, kat]
    harness: ztest
    platform_allow: [qemu_x86_64]
    integration_platforms: [qemu_x86_64]
    timeout: 300
  pqcp.acvp_kat.mlkem_1024_encaps:
    tags: [pqcp, acvp, kat]
    harness: ztest
    platform_allow: [qemu_x86_64]
    integration_platforms: [qemu_x86_64]
    timeout: 300
  pqcp.acvp_kat.mldsa_44_sign:
    tags: [pqcp, acvp, kat]
    harness: ztest
    platform_allow: [qemu_x86_64]
    integration_platforms: [qemu_x86_64]
    timeout: 300
  pqcp.acvp_kat.mldsa_44_verify:
    tags: [pqcp, acvp, kat]
    harness: ztest
    platform_allow: [qemu_x86_64]
    integration_platforms: [qemu_x86_64]
    timeout: 300
  pqcp.acvp_kat.mldsa_65_sign:
    tags: [pqcp, acvp, kat]
    harness: ztest
    platform_allow: [qemu_x86_64]
    integration_platforms: [qemu_x86_64]
    timeout: 300
  pqcp.acvp_kat.mldsa_65_verify:
    tags: [pqcp, acvp, kat]
    harness: ztest
    platform_allow: [qemu_x86_64]
    integration_platforms: [qemu_x86_64]
    timeout: 300
  pqcp.acvp_kat.mldsa_87_sign:
    tags: [pqcp, acvp, kat]
    harness: ztest
    platform_allow: [qemu_x86_64]
    integration_platforms: [qemu_x86_64]
    timeout: 300
  pqcp.acvp_kat.mldsa_87_verify:
    tags: [pqcp, acvp, kat]
    harness: ztest
    platform_allow: [qemu_x86_64]
    integration_platforms: [qemu_x86_64]
    timeout: 300
```

## tests/ztest_acvp_serial/testcase.yaml
```yaml
tests:
  pqcp.acvp_serial.garbage_rejected:
    tags:
      - pqcp
      - acvp
    harness: ztest
    platform_allow:
      - qemu_x86_64
      - nucleo_h743zi
    integration_platforms:
      - qemu_x86_64
    timeout: 120

  pqcp.acvp_serial.recovery_after_garbage:
    tags:
      - pqcp
      - acvp
    harness: ztest
    platform_allow:
      - qemu_x86_64
      - nucleo_h743zi
    integration_platforms:
      - qemu_x86_64
    timeout: 120

  pqcp.acvp_serial.oversize_frame_rejected:
    tags:
      - pqcp
      - acvp
    harness: ztest
    platform_allow:
      - qemu_x86_64
      - nucleo_h743zi
    integration_platforms:
      - qemu_x86_64
    timeout: 120
```

## tests/ztest_acvp_serial_negative/testcase.yaml
```yaml
tests:
  pqcp.acvp_serial.negative_replay:
    tags:
      - pqcp
      - acvp
      - negative
    harness: ztest
    platform_allow:
      - qemu_x86_64
      - nucleo_h743zi
    integration_platforms:
      - qemu_x86_64
    timeout: 120
```

## tests/ztest_ct_instr/testcase.yaml
```yaml
# SPDX-License-Identifier: LicenseRef-Proprietary-Collaborative-Evaluation

tests:
  pqcp.ct_instruction_regions:
    tags:
      - pqcp
      - crypto
      - constant_time
    platform_allow:
      - qemu_x86_64
    integration_platforms:
      - qemu_x86_64
```

## tests/ztest_ct_smoke/testcase.yaml
```yaml
tests:
  pqcp.ct_smoke:
    tags:
      - pqcp
      - security
      - ct
    harness: ztest
    platform_allow:
      - qemu_x86_64
      - nucleo_h743zi
    integration_platforms:
      - qemu_x86_64
    timeout: 180
```

## tests/ztest_deployment_advisor/testcase.yaml
```yaml
# SPDX-License-Identifier: LicenseRef-Proprietary-Collaborative-Evaluation

tests:
  pqcp.deployment_advisor:
    tags:
      - pqcp
      - deployment
      - evidence
    platform_allow:
      - qemu_x86_64
      - native_sim
    integration_platforms:
      - qemu_x86_64
```

## tests/ztest_deployment_campaign/testcase.yaml
```yaml
# SPDX-License-Identifier: LicenseRef-Proprietary-Collaborative-Evaluation
tests:
  pqcp.deployment_campaign:
    tags: [pqcp, deployment, evidence]
    platform_allow: [qemu_x86_64, native_sim]
    integration_platforms: [qemu_x86_64]
    timeout: 60
```

## tests/ztest_primitive/testcase.yaml
```yaml
tests:
  pqcp.primitive.core:
    tags:
      - pqcp
      - primitive
    harness: ztest
    platform_allow:
      - qemu_x86_64
      - mps2/an385
      - nucleo_h743zi
    integration_platforms:
      - qemu_x86_64
    timeout: 180

  pqcp.primitive.psa:
    tags:
      - pqcp
      - primitive
      - psa
    harness: ztest
    platform_allow:
      - qemu_x86_64
    integration_platforms:
      - qemu_x86_64
    timeout: 180
    extra_args:
      - OVERLAY_CONFIG=overlay-psa.conf

  pqcp.primitive.no_entropy:
    tags:
      - pqcp
      - primitive
    harness: ztest
    platform_allow:
      - mps2/an385
    integration_platforms:
      - mps2/an385
    timeout: 180
    extra_args:
      - OVERLAY_CONFIG=overlay-no-entropy.conf
```

## tests/ztest_rng/testcase.yaml
```yaml
tests:
  pqcp.rng.core:
    tags:
      - pqcp
      - rng
    harness: ztest
    platform_allow:
      - qemu_x86_64
    integration_platforms:
      - qemu_x86_64
    timeout: 120
```

## tests/ztest_tls_selftest/testcase.yaml
```yaml
tests:
  pqcp.tls_selftest.init_psa:
    tags:
      - pqcp
      - tls
      - psa
    harness: ztest
    platform_allow:
      - qemu_x86_64
    integration_platforms:
      - qemu_x86_64
    timeout: 180

  pqcp.tls_selftest.run:
    tags:
      - pqcp
      - tls
      - psa
    harness: ztest
    platform_allow:
      - qemu_x86_64
    integration_platforms:
      - qemu_x86_64
    timeout: 300
```

## west.yml
```yaml
manifest:
  self:
    path: zephyr-embedded-pqc-benchmarking

  remotes:
    - name: zephyrproject-rtos
      url-base: https://github.com/zephyrproject-rtos
    - name: pqcp
      url-base: https://github.com/pq-code-package

  defaults:
    remote: zephyrproject-rtos

  projects:
    - name: zephyr
      remote: zephyrproject-rtos
      revision: 684c9e8f32e4373a21098559f748f06915f950c9
      import: true
    - name: mlkem-native
      remote: pqcp
      revision: e07bff537f38b457601e524038f2395e235b011b
      path: modules/crypto/mlkem-native
    - name: mldsa-native
      remote: pqcp
      revision: 0f8b8e074b2525eb844b022b03b962bf888d51aa
      path: modules/crypto/mldsa-native
```
